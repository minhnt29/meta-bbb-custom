## conf/layer.conf
```bitbake
# We have a conf and classes directory, add to BBPATH
BBPATH .= ":${LAYERDIR}"
 
# We have recipes-* directories, add to BBFILES
BBFILES += "${LAYERDIR}/recipes-*/*/*.bb \
            ${LAYERDIR}/recipes-*/*/*/*.bbappend"
 
PREFERRED_PROVIDER_virtual/uboot = "u-boot-ti-staging"
PREFERRED_VERSION_u-boot = "2023.04*"
EXTRA_IMAGEDEPENDS += "u-boot"
 
# Enable systemd for serial console and services
DISTRO_FEATURES:append = " systemd"
VIRTUAL-RUNTIME_init_manager = "systemd"
DISTRO_FEATURES_BACKFILL_CONSIDERED += "sysvinit"
VIRTUAL-RUNTIME_initscripts = ""
SYSTEMD_AUTO_ENABLE = "enable"
 
BBFILE_COLLECTIONS += "meta-bbb-custom"
BBFILE_PATTERN_meta-bbb-custom = "^${LAYERDIR}/"
BBFILE_PRIORITY_meta-bbb-custom = "6"
IMAGE_ROOTFS_MAXSIZE = "3500000"

IMAGE_ROOTFS_SIZE = "3145728"
IMAGE_OVERHEAD_FACTOR = "1.0"
IMAGE_ROOTFS_EXTRA_SPACE = "0"
 
LAYERDEPENDS_meta-bbb-custom = "core"
LAYERSERIES_COMPAT_meta-bbb-custom = "kirkstone"
```
